/***********************************************************************************************************************
* Copyright (C) . All rights reserved.
***********************************************************************************************************************/

/***********************************************************************************************************************
* File Name    : main.c
* Version      :  
* Device(s)    : CMS32L032
* Tool-Chain   : MDK(armcc)
* Description  : This file is a template.
* Creation Date: 2019/4/30
***********************************************************************************************************************/

/***********************************************************************************************************************
Macro Definitions
***********************************************************************************************************************/

/***********************************************************************************************************************
Includes
***********************************************************************************************************************/
#include "CMS32L032.h"
#include "userdefine.h"
#include "gpio.h"
#include "key.h"

/***********************************************************************************************************************
Pragma directive
***********************************************************************************************************************/

/***********************************************************************************************************************
Global variables and functions
***********************************************************************************************************************/
volatile uint32_t g_ticks;

void delayMS(uint32_t n)
{
		g_ticks = n;
		while(g_ticks);
}

int main()
{
	uint32_t msCnt; 	// count value of 1ms
	uint32_t i;

//-----------------------------------------------------------------------
// Initialize the ports to prevent the leakage current 
//-----------------------------------------------------------------------
	GPIO_PullUp_Enable(&PORT->P0, 0xFF);
	GPIO_PullUp_Enable(&PORT->P1, 0xFF);
	GPIO_PullUp_Enable(&PORT->P2, 0xFF);
	GPIO_PullUp_Enable(&PORT->P3, 0xFF);
	
//-----------------------------------------------------------------------
// P140/PCLBUZ0 output 
//-----------------------------------------------------------------------  
	CLKBUZ0_PORT_SETTING();
	PCBZ->CKS0  = 0x83;    	// FMAIN/2^3	
	
//-----------------------------------------------------------------------
// Systick setting 
//-----------------------------------------------------------------------   
	g_ticks = 1000; 	// 1000ms
	SystemCoreClockUpdate();
	msCnt = SystemCoreClock / 1000;
	SysTick_Config(msCnt);
	
//-----------------------------------------------------------------------
// Enable KR0 falling edge interrupt request to wakeup system
//-----------------------------------------------------------------------   
	KEY_Init(1 << 2);               // Initializes P32/KR0
	KEY_Start();                    // Enable KEY Interrupt
	
//-----------------------------------------------------------------------
// LED ON (500ms) --> LED OFF
//----------------------------------------------------------------------- 
	GPIO_Output_Enable(&PORT->P3, 3 << 0);   // P31, P30 output enable
	GPIO_Set_Value(&PORT->P3, 0x00);         // LED ON: P31, P30 output low Level
	delayMS(500);                            // LED ON: 500ms for reconnect debugger
	GPIO_Set_Value(&PORT->P3, 0x06);         // LED OFF: P31, P30 output High Level
	
//-----------------------------------------------------------------------
// DeepSleep 10 times
// P32/KR0 falling edge wakeup system and blinky P31 LED
//-----------------------------------------------------------------------

	for(i=10; i>0; )
	{
		/*** enter power down ***/
				CGC->PMUKEY = 0x192A;
				CGC->PMUKEY = 0x3E4F;
				CGC->PMUCTL = 1;

				/* disable LVR */
				LVD->LVIM = 0x80;//disable LVR,option byte 0xC1 select interrupt&reset mode
				__STOP(); 		// DeepSleep
				/* enable LVR */
				LVD->LVIM = 0x00;
		
		delayMS(20); 	// Filter out key jitter
		if(0U == (PORT->P3 & 0x01)) // check key value is 0
		{
			PORT->P3 ^= (1 << 1); 	// P31 toggle 
			i--;
		}
	}

//-----------------------------------------------------------------------
// LED blinky on target board 
// P31, 30 drives LED on board
//----------------------------------------------------------------------- 
	// LED Blinky
	PORT->P3 = 0x02U;  
	while(1)
	{
		delayMS(250);
		PORT->P3 ^= (3<<1); 	// Toggle P31, P30
	}
}

/***********************************************************************************************************************
* Function Name: SysTick Handler
* Description  : Decreament the g_ticks value
* Arguments    : None
* Return Value : None
***********************************************************************************************************************/
void SysTick_Handler(void)
{
	g_ticks--;
}

